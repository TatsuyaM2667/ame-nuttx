## apps/ame/ame-fetch/Kconfig
```kconfig
config AME_FETCH
	bool "Ame NuttX system info"
	default n
	---help---
		Display system information in Ame style.
```

## apps/ame/ame-logo/Kconfig
```kconfig
config AME_LOGO
	bool "Ame Linux logo"
	default n
	---help---
		Display Ame Linux ASCII logo with ANSI 256-color gradient.
```
